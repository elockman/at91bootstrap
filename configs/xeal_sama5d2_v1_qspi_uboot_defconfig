## configs/xeal_sama5d2_v1_qspi_uboot_defconfig
```kconfig
# Copyright (C) 2006 Microchip Technology Inc. and its subsidiaries
#
# SPDX-License-Identifier: MIT

CONFIG_SAMA5D2=y
CONFIG_CRYSTAL_12_000MHZ=y
CONFIG_BUS_SPEED_166MHZ=y
CONFIG_DEBUG=y
CONFIG_DDR_SET_BY_DEVICE=y
# 512MB
CONFIG_DDR_W9751G6KB=y
# 1GB
# CONFIG_DDR_W971GG6SB_D2=y
CONFIG_SPI_CLK=66000000
CONFIG_QSPI=y
CONFIG_QSPI_BUS=1
CONFIG_QSPI_IOSET=2
CONFIG_IMG_ADDRESS="0x00040000"
CONFIG_JUMP_ADDR="0x23f00000"
# CONFIG_ENTER_NWD is not set
CONFIG_BOARD_QUIRK_SAMA5D2_SIP=y
CONFIG_LED_ON_BOARD=y
CONFIG_LED_R_ON_PIOC=y
CONFIG_LED_R_PIN=24
CONFIG_LED_G_ON_PIOC=y
CONFIG_LED_G_PIN=15
CONFIG_LED_B_ON_PIOC=y
CONFIG_LED_B_PIN=10
```
